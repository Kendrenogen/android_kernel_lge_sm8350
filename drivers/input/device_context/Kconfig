## drivers/input/device_context/Kconfig
```kconfig
#
# Fingerprints driver configuration
#
menuconfig LGE_DEVICE_CONTEXT
	bool "LGE_DEVICE_CONTEXT"
	help
	  Say Y here, and a list of supported fingerprints will be displayed.
	  This option doesn't affect the kernel.

	  If unsure, say Y.

if LGE_DEVICE_CONTEXT

config LGE_DEVICE_CONTEXT_MON
	tristate "LGE Device context monitor support"
	help
	  Say Y here to enable LGE Device context monitor driver support!
endif
```

## drivers/input/fingerprint/Kconfig
```kconfig
#
# Fingerprints driver configuration
#
menuconfig INPUT_FINGERPRINT
	bool "FingerPrints"
	help
	  Say Y here, and a list of supported fingerprints will be displayed.
	  This option doesn't affect the kernel.

	  If unsure, say Y.

if INPUT_FINGERPRINT

config INPUT_FINGERPRINT_FPC
	tristate "FPC fingerprint platform driver support"
	help
	  Say Y here to enable fpc fingerprint platform driver support!

config LGE_FINGERPRINT_GKI_FPC
	bool "FPC fingerprint driver feature for GKI build"
	depends on INPUT_FINGERPRINT_FPC
	help
	  Say Y here to build fpc fingerprint platform driver for GKI build
endif
```

## drivers/input/optical/Kconfig
```kconfig
#
# Input misc drivers configuration
#
menuconfig INPUT_OTS
	bool "OTS Sensor devices"
	help
	  Say Y here, and a list of Sensor input drivers will be displayed.
	  Everything that didn't fit into the other categories is here. This option
	  doesn't affect the kernel.

	  If unsure, say Y.

config LGE_SENSOR_OPTICAL_SENSOR_PIXART
    tristate "Pixart Optical sensor support"
    depends on I2C
    default n
    help
        If you say yes here you get support for Pixart's
        ots sensors.
```

## drivers/input/touchscreen/lge/module/Kconfig
```kconfig
#
# LGE touch core configuration
#
if INPUT_TOUCHSCREEN

menuconfig LGE_TOUCH_DLKM_LGSIC_SW82906
        tristate "LGE Touch Core ODM Device Driver - SW82906"
        depends on LGE_TOUCH_CORE_BASE
        help
          If your device is sw82906, say Y
	  If you want to dynamic load sw82906 module for input driver, yes 'm' here

menuconfig LGE_TOUCH_DLKM_LGSIC_SW82908
        tristate "LGE Touch Core ODM Device Driver - SW82908"
        depends on LGE_TOUCH_CORE_BASE
        help
          If your device is sw82908, say Y
	  If you want to dynamic load sw82908 module for input driver, yes 'm' here

# To Do : LGSIC Chipseet
endif
```

## drivers/motors/Kconfig
```kconfig
######################################
# Rolling Motor Driver configuration #
######################################

menu "Motor Device Drivers"

config LGE_ROLLING
	bool "LGE_ROLLING"
	select LGE_MOTOR_PWM_GENERATOR_LATTICE   if LGE_MOTOR_PWM_GENERATOR="lattice"  
	select LGE_MOTOR_PWM_GENERATOR_PM8350    if LGE_MOTOR_PWM_GENERATOR="pm8350"
	help
	  This option provides the function about motor pwm driver.

# PWM Generator
config LGE_MOTOR_PWM_GENERATOR
	string "Default Motor Type"
	depends on LGE_ROLLING
	help
	  Select the motor Type

config LGE_MOTOR_PWM_GENERATOR_LATTICE
	bool "Default Motor PWM Generator to LATTICE MCU"
	depends on LGE_ROLLING
	help
	  Select the Motor PWM Generator to LATTICE MCU : ice40

config LGE_MOTOR_PWM_GENERATOR_PM8350
	bool "Default Motor PWM Generator to PM8350"
	depends on LGE_ROLLING
	help
	  Select the Motor PWM Generator to PM8350

# Test volume key control
config LGE_MOTOR_CONTROL_VOLUME_KEY
	bool "Test Code for Motor Control Volume key"
	depends on LGE_ROLLING
	help
	  To GPIO Key control

endmenu
```

## drivers/nfc/lge/Kconfig
```kconfig
#
# Nxp SPi protocol (SPI) devices
#

config NFC_SELECTIVE_DRIVER
	tristate "NFC_SELECTIVE_DRIVER"
	default n
```

## drivers/nfc/sn100x/Kconfig
```kconfig
#
# Nxp Nci protocol (I2C) devices
#

#config NFC_PN553_DEVICES
#	tristate "NXP NCI based NFC I2C Slave Driver for SNxxx"
#	depends on I2C
#	---help---
#	  You'll have to say Y if your computer contains an I2C device that
#	  you want to use under Linux.
#
#	  You can say N here if you don't have any SPI connected to your computer.

### LGE_START ###

config LGE_NFC
	bool "NFC Device Enabled for LGE"
	default n

config LGE_NFC_SN100X
	tristate "SN100 NFC driver"
	depends on I2C
	default n
	---help---
	  Say yes if you want PN553 Near Field Communication driver.
	  This is for i2c connected version. If unsure, say N here.

	  To compile this driver as a module, choose m here. The module will
	  be called pn553.

config LGE_NFC_SET_IRQ_WAKEUP
	bool "NFC Set IRQ wakeup when NFC ON"
	default n
	---help---
	  Say yes if Set IRQ Wakeup NFC ON.
	  If unsure, say N here.

config LGE_NFC_DEBUG_MESSAGE
	bool "NFC Debug Message"
	default n

config LGE_NFC_GKI
	bool "NFC GKI"
	default n
### LGE_END ###
```

## drivers/scsi/Kconfig.lfs
```kconfig
config LFS_SCSI
	bool
	default y if LFS_COMMON

config LFS_SCSI_DEVICE_IDENTIFIER
	bool
	default y if LFS_COMMON
```

## drivers/soc/qcom/lge/Kconfig
```kconfig
config MACH_LGE
	bool "Machine LGE"
	help
		Support for machine LGE.

menu "LGE Board Selection"

config LGE_PM
	tristate "LAHAINA(SM8350) LGE POWER Feature"
	depends on SPMI || MSM_SPMI
	help
		Say Y here to enable support for LAHAINA(SM8350)/PM8350 chip lge feature.
		Power Management, Battery charging, Battery Monitoring System
		with battery FET and fuel gauge.

config LGE_PM_DEBUG
	tristate "Support LGE PM Debug feature"
	default n
	depends on MACH_LGE
	help
		LGE PM Debug Feature

config MACH_LAHAINA_BLM
	bool "LAHAINA BLM"
	depends on ARCH_LAHAINA
	select MACH_LGE
	help
		Support for the Qualcomm LAHAINA(SM8350) BLM device.

config MACH_LAHAINA_BLM_LDU
	bool "LAHAINA BLM_LDU"
	depends on ARCH_LAHAINA
	select MACH_LGE
	help
		Support for the Qualcomm LAHAINA(SM8350) BLM LDU device.

config MACH_LAHAINA_RAINBOWLM
	bool "LAHAINA RAINBOWLM"
	depends on ARCH_LAHAINA
	select MACH_LGE
	help
		Support for the Qualcomm LAHAINA(SM8350) RAINBOWLM device.

config MACH_LAHAINA_RAINBOWLM_LDU
	bool "LAHAINA RAINBOWLM_LDU"
	depends on ARCH_LAHAINA
	select MACH_LGE
	help
		Support for the Qualcomm LAHAINA(SM8350) RAINBOWLM LDU device.

config LGE_PM_PRM
	tristate "Support LGE Power resource manager"
	help
	  LGE power resource manager

endmenu

menu "LGE Specific Patches"

config LGE_DEVICES_SUPPORT
	tristate "Support utils for LGE devices"
	default n
	help
	  LGE devices support

config LGE_HANDLE_PANIC
	tristate "Support LGE Crash Handler"
	default n
	depends on MACH_LGE
	select LGE_HANDLE_PANIC_RPMH_TIMEOUT
	help
	  LGE Crash Handler

config LGE_HANDLE_PANIC_RPMH_TIMEOUT
	tristate "Support LGE Crash Handler RPMH Timeout"
	default n
	depends on LGE_HANDLE_PANIC
	help
	  LGE Crash Handler

config LGE_BOOTLOADER_LOG
	tristate "Support LGE bootloader log"
	default n
	depends on MACH_LGE
	help
	  LGE bootloader log

config LGE_BOOTLOADER_TIME_CHECKER
	tristate "Supprt bootloader(LK, SBL) time"
	default n
	depends on MACH_LGE
	help
	  Check LK, SBL booting time at
	  sys/module/lge_bootloader_time_checker/parameters/lk_time
	  sys/module/lge_bootloader_time_checker/parameters/sbl_time

config LGE_QSDL_SUPPORT
	tristate "Support for Quality Statistics Data Logging"
	default n
	depends on MACH_LGE
	help
	  QSDL is a feature which notify infomation for quality statistics
	  data logging of device.

config LGE_ONE_BINARY_SKU
	tristate "Support LGE One binary sku carrier"
	default n
	depends on MACH_LGE
	help
	  LGE One Binary sku carrier

config LGE_PON_RESTART_REASON
    bool "Support for LGE PON RESTART REASON"
    depends on MACH_LGE
    help
      Say 'y' here to include support for LGE PON RESTART REASON.

config LGE_MME_BUS
        bool "boost interface for LGE MME"
        depends on MACH_LGE
        help
          Say 'y' here to include support for the boost interface
          of msm bus to support LGE MME.

config LGE_MME_BOOST
        bool "booster for LGE MME"
        depends on LGE_MME_BUS
        help
          Say 'y' here to include support for the boost
          of msm bus to support LGE MME.

config LGE_MME_BOOST_LONG_TERM
        bool "Long term booster for LGE MME"
        depends on LGE_MME_BUS
        help
          Say 'y' here to include support for the long term boost
          of msm bus to support LGE MME.

config LGE_MME_BOOST_EBI
        bool "EBI Clock booster for LGE MME"
        depends on LGE_MME_BUS
        help
          Say 'y' here to include support for the ebi clock boost
          of msm bus to support LGE MME.

config LGE_MME_PM_QOS_DMA_LATENCY
        bool "PM QOS DMA latency for LGE MME"
        depends on LGE_MME_BUS
        help
          Say 'y' here to include support for PM QOS DMA Latency
          of msm bus to support LGE MME.

config LGE_MME_DRV
        tristate "Support WMC driver"
        depends on MACH_LGE
        default m
        help
          Say 'y' here to enable Wireless Magnetic Communication driver for LG pay

config LGE_MME_TEST
        tristate "Support WMC driver test"
        depends on MACH_LGE
        help
          Say 'y' here to enable Wireless Magnetic Communication driver for LG pay

config LGE_POWEROFF_TIMEOUT
	bool "Support shutdown and reboot timeout"
	depends on MACH_LGE
	default y
	help
	  Say 'y" here to include support for shutdown and reboot timeout.

config LFS_COMMON
        bool "Support LGE Filesystem Kernel Feature"
        default y if MACH_LGE
        select NLS_UTF8
        help
          Say 'y' here to enable LGE Filesystem Features

config LGE_SUPPORT_HALLIC
	bool "LGE Hall IC Support"
        default y if MACH_LGE
	help
	  Say Y here if you want to use LGE hallic

config LGE_DISPLAY_DIMMING_BOOT_SUPPORT
	bool "Support dimming boot"
	depends on MACH_LGE
	help
	  Say 'y" here to include support for dimming boot.

config LGE_SUPPORT_WMC_FAULT_N
	bool "LGE WMC_FAULT_N Support"
	depends on LGE_MME_DRV || LGE_MME_TEST
	default n
	help
	  Say Y here if device has WMC_FAULT_N gpio

config LGE_PM_SMPL_COUNTER
	tristate "Support LGE SMPL COUNTER feature"
	default n
	depends on MACH_LGE
	help
	  Say y to enable smpl_cnt module, that count when
	  booted by SMPL

config LGE_RESERVED_GPIO_BLM
	bool "Support LGE_RESERVED_GPIO_BLM feature"
	default n
	help
	  Say y to enable Reserved GPIO for BLM

config LGE_RESERVED_GPIO_RAINBOWLM
	bool "Support LGE_RESERVED_GPIO_RAINBOWLM feature"
	default n
	help
	  Say y to enable Reserved GPIO for RAINBOWLM

config LGE_SREADAHEAD
        bool "Support S-ReadAhead"
	default n
	help
	  Say y to enable S-ReadAhead

endmenu
```

## drivers/staging/android/application_manager/Kconfig
```kconfig
config APPLICATION_MANAGER
	bool "Enable the application manager for Android"
	default n
	help
	  The application manager recognizes the usage pattern of the
	  user's application and improves performance through application
	  management that matches the recognized pattern.

	  The application manager improves the average entry time of
	  applications by up to 35%, when there are usage patterns.
```

## fs/Kconfig.lfs
```kconfig
config LFS_SUSPEND_BGSYNC
	bool
	default y if LFS_COMMON

config LFS_IOSCHED_EXTENSION
	bool
	default y if LFS_COMMON

config LFS_IOSCHED_CFQ_PREEMPT
	bool
	default y if LFS_COMMON

config LFS_EXT4
	bool
	default y if LFS_COMMON

config LFS_F2FS
	bool
	default y if LFS_COMMON

config LFS_FAT_FIX_BAD_FORMAT
	bool
	default y if LFS_COMMON

config LFS_EXFAT
	bool
	default y if LFS_COMMON && EXFAT_FS
```

## techpack/camera/Kconfig
```kconfig
# SPDX-License-Identifier: GPL-2.0-only

config LGE_CAMERA
	bool "LGE Camera"
	help
		Support for LGE CAMERA.

config BLM_CAMERA
	bool "BLM Camera"
	help
		Support for LGE BLM CAMERA.

config RAINBOWLM_CAMERA
	bool "RAINBOWLM Camera"
	help
		Support for LGE RAINBOWLM CAMERA.
```
