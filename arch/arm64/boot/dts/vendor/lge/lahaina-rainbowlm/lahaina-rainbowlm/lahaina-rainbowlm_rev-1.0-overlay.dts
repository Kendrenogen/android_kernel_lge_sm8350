/dts-v1/;
/plugin/;

#include "lahaina-rainbowlm.dtsi"
#include "lahaina-rainbowlm-sound.dtsi"
#include "lahaina-rainbowlm-buttonless.dtsi"
#include "../lahaina-rainbowlm_camera/lahaina-rainbowlm_camera_rev-a.dtsi"

/ {
    model = "LG Electronics, Rainbowlm, rev.1.0";
    compatible = "qcom,lahaina-mtp", "qcom,lahaina", "qcom,mtp";
    qcom,board-id = <0x000C0008 0>;
};

&lge_sbu_switch {
    lge,uart-sbu-sel-gpio = <&tlmm 124 GPIO_ACTIVE_LOW>;
};

&usb2_phy0 {
    qcom,hsusb-phy-tune = <0xE1 0x0D 0x2E 0x03>;
};
