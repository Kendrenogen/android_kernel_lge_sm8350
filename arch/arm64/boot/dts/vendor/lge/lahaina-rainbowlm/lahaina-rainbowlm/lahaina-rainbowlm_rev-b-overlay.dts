/dts-v1/;
/plugin/;

#include "lahaina-rainbowlm.dtsi"
#include "lahaina-rainbowlm-sound.dtsi"
#include "../lahaina-rainbowlm_common/lahaina-rainbowlm_common-buttonless-ussys-hub_rev-b.dtsi"
#include "../lahaina-rainbowlm_camera/lahaina-rainbowlm_camera_rev-a.dtsi"

/ {
    model = "LG Electronics, Rainbowlm, rev.B";
    compatible = "qcom,lahaina-mtp", "qcom,lahaina", "qcom,mtp";
    qcom,board-id = <0x00070008 0>;
};

