#include "../lahaina-rainbowlm_common/lahaina-rainbowlm_common-nfc.dtsi"

&qupv3_se15_i2c {
    status = "ok";
    qcom,clk-freq-out = <1000000>;
    #address-cells = <1>;
    #size-cells = <0>;

    pn547@28 {
        compatible = "nxp,pn547";
        reg = <0x28>;
        status = "ok";
        nxp,gpio_sda = <&tlmm 60 0x00>;
        nxp,gpio_scl = <&tlmm 61 0x00>;
        nxp,gpio_ven = <&tlmm 66 0x00>;
        nxp,gpio_mode = <&tlmm 86 0x00>;
        nxp,gpio_irq = <&tlmm 87 0x00>;
        nxp,i2c-pull-up = <1>;
        qcom,clk-src = "BBCLK2";
        interrupt-parent = <&tlmm>;
        interrupts = <87 0>;
        interrupt-names = "nfc_irq";
    };
};
