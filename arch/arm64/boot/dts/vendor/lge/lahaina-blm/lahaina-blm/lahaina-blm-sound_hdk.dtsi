#include "../../../qcom/lahaina-audio-overlay.dtsi"

&dai_mi2s2 {
    qcom,msm-mi2s-tx-lines = <1>;
    pinctrl-names = "default", "sleep";
    pinctrl-0 = <&tert_mi2s_sck_active &tert_mi2s_ws_active
            &tert_mi2s_sd0_active>;
    pinctrl-1 = <&tert_mi2s_sck_sleep &tert_mi2s_ws_sleep
            &tert_mi2s_sd0_sleep>;
};