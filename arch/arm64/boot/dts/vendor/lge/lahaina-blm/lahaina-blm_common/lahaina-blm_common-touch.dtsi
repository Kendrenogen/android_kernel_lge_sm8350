// SPDX-License-Identifier: GPL-2.0-only
/*
 * Copyright (c) 2018-2019, The Linux Foundation. All rights reserved.
 */

&qupv3_se4_i2c {
	#address-cells = <1>;
	#size-cells = <0>;

	status = "ok";
	qcom,i2c-touch-active = "lge,sw82906";

	sw82906@28 {
		compatible = "lge,sw82906";
		reg = <0x28>;
		status = "ok";
		interrupt-parent = <&tlmm>;
		interrupts = <23 0x2008>;
		irqflags = <0x00000002>;

		vdd-supply = <&pm8350c_l2>;
		vcl-gpio = <&pm8350c_gpios 7 0x00>;
		reset-gpio = <&tlmm 22 0x00>;
		irq-gpio = <&tlmm 23 0x2008>;

		/* caps */
		max_x = <1875>;
		max_y = <2427>;
		max_pressure = <0xff>;
		max_width_major = <2427>;
		max_width_minor = <2427>;
		max_orientation = <90>;
		max_id = <10>;
		hw_reset_delay = <90>;
		sw_reset_delay = <10>;
		flexible_display_info_update_frequency = <300>;

		/* role */
		use_lpwg = <1>;
		use_lpwg_test = <1>;
		hide_coordinate = <1>;
		use_activepen_status = <0>;
		use_film_status = <1>;
		use_dex_mode = <1>;
		hidden_coordi_enable = <0>;

		/* firmware */
		fw_image = "touch/bpjt/B3W74BPJT_VER0_71.img";

		panel_spec = "touch/bpjt/B_PJT_limit.txt";
		panel_spec_mfts_folder = "touch/bpjt/B_PJT_limit.txt";

		/* asc */
		use_asc = <0>;
		low_delta_thres = <350>;
		high_delta_thres = <600>;
		max_delta_cnt = <2>;

		/* Performance Test */
		use_perf_test = <1>;
		test_delay = <8>;
		test_pressure = <50>;
		test_width = <100>;
		click_test_x = <180>;
		click_test_y = <760>;
		v_drag_test_x = <144>;
		v_drag_test_start_y = <2003>;
		v_drag_test_end_y = <1116>;
		h_drag_test_start_x = <1163>;
		h_drag_test_end_x = <276>;
		h_drag_test_y = <2184>;
	};

	sw42902@29 {
		compatible = "lge,sw42902";
		reg = <0x29>;
		status = "disable";
		interrupt-parent = <&tlmm>;
		interrupts = <23 0x2008>;
		irqflags = <0x00000002>;

		//vdd-gpio = <&tlmm 68 0x00>;
		//vdd-supply = <&pm8150_l15>;
		vdd-supply = <&pm8350c_l2>;
		//vcl-gpio = <&tlmm 67 0x00>;
		vcl-gpio = <&pm8350c_gpios 7 0x00>;
		reset-gpio = <&tlmm 22 0x00>;
		irq-gpio = <&tlmm 23 0x2008>;

		/* caps */
		max_x = <1080>;
		max_y = <2460>;
		max_pressure = <0xff>;
		max_width_major = <2460>;
		max_width_minor = <2460>;
		max_orientation = <90>;
		max_id = <10>;
		hw_reset_delay = <90>;
		sw_reset_delay = <10>;

		/* role */
		use_lpwg = <1>;
		use_lpwg_test = <1>;
		hide_coordinate = <1>;
		use_activepen_status = <1>;
		use_film_status = <1>;

		/* firmware */
		fw_image = "touch/timelm/B3W68TIME_0_57.img",
			   "touch/timelm/B3W68DS3_0_16.img";

		panel_spec = "touch/timelm/Time_limit.txt";
		panel_spec_mfts_folder = "touch/timelm/Time_limit.txt";

		/* asc */
		use_asc = <0>;
		low_delta_thres = <350>;
		high_delta_thres = <600>;
		max_delta_cnt = <2>;

		/* Performance Test */
		use_perf_test = <1>;
		test_delay = <8>;
		test_pressure = <50>;
		test_width = <100>;
		click_test_x = <180>;
		click_test_y = <760>;
		v_drag_test_x = <144>;
		v_drag_test_start_y = <2003>;
		v_drag_test_end_y = <1116>;
		h_drag_test_start_x = <1163>;
		h_drag_test_end_x = <276>;
		h_drag_test_y = <2184>;
	};
};
