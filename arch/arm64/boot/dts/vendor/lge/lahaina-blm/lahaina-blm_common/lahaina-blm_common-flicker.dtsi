// SPDX-License-Identifier: GPL-2.0-only
/*
 * Copyright (c) 2018-2019, The Linux Foundation. All rights reserved.
 */

&qupv3_se1_i2c { /* QUP_1 (Flicker) */
	qcom,clk-freq-out = <400000>;
	status = "ok";
	tcs3407@39 {
		compatible = "ams_tcs3407";
		reg = <0x39>;
		/*
		ams,gpio_irq = <&tlmm 96 0x00>;
		interrupt-parent = <&tlmm>;
		interrupts = <96 0x0>;
		pinctrl-names = "default", "sleep";
		pinctrl-0 = <&tcs3407_int_active>;
		pinctrl-1 = <&tcs3407_int_suspend>;
		*/
		qcom,clk-src = "BBCLK2";
		status = "ok";
	};
};